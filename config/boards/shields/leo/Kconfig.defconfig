## config/boards/shields/leo/Kconfig.defconfig
```kconfig
# Copyright (c) 2021 The ZMK Contributors
# SPDX-License-Identifier: MIT


if SHIELD_LEO_DONGLE

config ZMK_KEYBOARD_NAME
    default "LEO"

config ZMK_SPLIT_BLE_ROLE_CENTRAL
    default y

config ZMK_USB
    default y

endif

if SHIELD_LEO_LEFT || SHIELD_LEO_RIGHT || SHIELD_LEO_DONGLE

config ZMK_SPLIT
    default y

config ZMK_BLE
    default y

endif
```

## config/boards/shields/leo/Kconfig.shield
```kconfig
# Copyright (c) 2021 The ZMK Contributors
# SPDX-License-Identifier: MIT

config SHIELD_LEO_LEFT
    def_bool $(shields_list_contains,leo_left)

config SHIELD_LEO_RIGHT
    def_bool $(shields_list_contains,leo_right)

config SHIELD_LEO_DONGLE
	def_bool $(shields_list_contains,leo_dongle)
```
